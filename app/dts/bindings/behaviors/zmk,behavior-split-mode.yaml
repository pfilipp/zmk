## app/dts/bindings/behaviors/zmk,behavior-split-mode.yaml
```yaml
# Copyright (c) 2026 The ZMK Contributors
# SPDX-License-Identifier: MIT

description: Split Mode Behavior (dongle mode vs standalone mode)

compatible: "zmk,behavior-split-mode"

include: two_param.yaml
```

## app/src/split/Kconfig
```kconfig
# Copyright (c) 2022 The ZMK Contributors
# SPDX-License-Identifier: MIT

menuconfig ZMK_SPLIT
    bool "Split keyboard support"

if ZMK_SPLIT

config ZMK_SPLIT_ROLE_CENTRAL
    bool "Split central device"

config ZMK_SPLIT_ROLE_DYNAMIC
    bool "Select the split role at boot from settings"
    depends on ZMK_SPLIT_BLE
    select ZMK_SPLIT_ROLE_CENTRAL
    help
      Link both the split central and the split peripheral into one image and
      pick the role at boot from the persisted split mode. The mode is changed
      with the &split_mode behavior, which reboots the device. Meant for a half
      that is sometimes a dongle's peripheral and sometimes the central itself.

config ZMK_SPLIT_CENTRAL_MODE_GATE
    bool "Dongle-side gate for a dynamic-role peripheral"
    depends on ZMK_SPLIT_ROLE_CENTRAL && !ZMK_SPLIT_ROLE_DYNAMIC
    help
      Remember whether a dynamic-role peripheral switched to standalone mode
      and, while it has, only accept connections from that peripheral so the
      other half can be taken by the standalone central.

config ZMK_SPLIT_PERIPHERAL_MULTI_BOND
    bool "Peripheral accepts connections from any bonded central"
    depends on ZMK_SPLIT_BLE && !ZMK_SPLIT_ROLE_CENTRAL
    select BT_FILTER_ACCEPT_LIST
    help
      Keep bonds to two centrals and advertise with a filter accept list
      containing all of them, so the peripheral follows whichever central is
      active without re-pairing.

config ZMK_SPLIT_BLE
    bool "BLE Split"
    default y
    depends on ZMK_BLE
    select BT_USER_PHY_UPDATE
    select BT_AUTO_PHY_UPDATE

config ZMK_SPLIT_WIRED
    bool "Wired Split"
    default y
    depends on DT_HAS_ZMK_WIRED_SPLIT_ENABLED
    select SERIAL
    select RING_BUFFER
    select CRC

config ZMK_SPLIT_PERIPHERAL_HID_INDICATORS
    bool "Peripheral HID Indicators"
    depends on ZMK_HID_INDICATORS
    help
      Enable propagating the HID (LED) Indicator state to the split peripheral(s).

endif # ZMK_SPLIT

rsource "bluetooth/Kconfig"
rsource "wired/Kconfig"
```
